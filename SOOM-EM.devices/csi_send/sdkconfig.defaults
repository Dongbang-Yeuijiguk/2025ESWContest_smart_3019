## SOOM-EM.devices/csi_send/sdkconfig.defaults
```kconfig
CONFIG_IDF_TARGET="esp32c6"
CONFIG_PARTITION_TABLE_OFFSET=0xa000
CONFIG_ESP_WIFI_DYNAMIC_TX_BUFFER_NUM=128
CONFIG_ESP_WIFI_CSI_ENABLED=y
CONFIG_ESP_WIFI_AMPDU_TX_ENABLED=n
CONFIG_FREERTOS_HZ=1000
```

## SOOM-EM.devices/smart_light/main/Kconfig.projbuild.example
```kconfig
menu "SOOM Smart Light Configuration"

    menu "Wi-Fi Settings"
        config WIFI_SSID
            string "Wi-Fi SSID"
            default "MyWiFi"
        config WIFI_PASS
            string "Wi-Fi Password"
            default "MyPassword"
    endmenu

    menu "MQTT Settings"
        config MQTT_BROKER_URI
            string "MQTT Broker URI"
            default "mqtt://192.168.0.10:1883"
        config MQTT_TOPIC_CMD
            string "MQTT Command Topic"
            default "sensor/smart_light/cmd"
        config MQTT_TOPIC_STATE
            string "MQTT State Topic"
            default "sensor/smart_light"
    endmenu

    menu "LED Strip Settings"
        config LED_STRIP_GPIO
            int "LED Strip GPIO"
            default 4
        config LED_STRIP_LED_COUNT
            int "Number of LEDs"
            default 40
        config STATE_PUB_PERIOD_MS
            int "State publish interval (ms)"
            default 5000
    endmenu

endmenu
```

## air_conditioner/main/Kconfig.projbuild.example
```kconfig
menu "SOOM Air Conditioner Configuration"

    menu "Wi-Fi Settings"
        config WIFI_SSID
            string "Wi-Fi SSID"
            default "MyWiFi"
        config WIFI_PASS
            string "Wi-Fi Password"
            default "MyPassword"
    endmenu

    menu "MQTT Settings"
        config MQTT_URI
            string "MQTT Broker URI"
            default "mqtt://192.168.0.10:1883"
        config MQTT_TOPIC_SENSOR
            string "MQTT Sensor Topic"
            default "sensor/aircondition"
        config MQTT_TOPIC_CMD
            string "MQTT Command Topic"
            default "sensor/air_conditioner/cmd"
    endmenu

    menu "GPIO Settings"
        config MOTOR_A1A
            int "Motor A1A GPIO"
            default 1
        config MOTOR_A1B
            int "Motor A1B GPIO"
            default 2
        config RELAY_GPIO
            int "Relay GPIO"
            default 3
        config DHT_GPIO
            int "DHT22 GPIO"
            default 4
    endmenu

endmenu
```

## smart_curtain/main/Kconfig.projbuild.example
```kconfig
menu "Smart Curtain Configuration"

    menu "Wi-Fi Settings"
        config WIFI_SSID
            string "Wi-Fi SSID"
            default "MyWiFi"

        config WIFI_PASSWORD
            string "Wi-Fi Password"
            default "MyPassword"
    endmenu

    menu "MQTT Settings"
        config MQTT_BROKER_URI
            string "MQTT Broker URI"
            default "mqtt://192.168.0.10:1883"

        config MQTT_TOPIC_CMD
            string "MQTT Command Topic"
            default "sensor/smart_curtain/cmd"

        config MQTT_TOPIC_STATE
            string "MQTT State Topic"
            default "sensor/smart_curtain"
    endmenu

    menu "Curtain Stepper Settings"
        config CURTAIN_STEP_GPIO
            int "Stepper STEP GPIO"
            default 3

        config CURTAIN_DIR_GPIO
            int "Stepper DIR GPIO"
            default 4

        config CURTAIN_EN_GPIO
            int "Stepper EN GPIO"
            default 8

        config CURTAIN_EN_ACTIVE_LOW
            bool "Enable Active Low"
            default y

        config CURTAIN_DIR_INVERTED
            bool "Invert Direction"
            default y

        config CURTAIN_PULSE_US
            int "Pulse width (us)"
            default 700

        config CURTAIN_STEP_GAP_US
            int "Step gap (us)"
            default 700

        config CURTAIN_TOTAL_STEPS
            int "Total steps to fully open"
            default 2000
    endmenu

endmenu
```
